## main/Kconfig.projbuild
```kconfig
menu "Example Configuration"
    config LV_MEM_SIZE_KILOBYTES
        int "Size of the memory used by `lv_mem_alloc` in kilobytes (>= 2kB)"
        default 48
    config BT_ENABLED
        bool "Select this option to enable Bluetooth"
        default y

    config BT_BLE_50_FEATURES_SUPPORTED
        bool "Enabling this option activates BLE 5.0 features"
        default y

    config BT_BLE_42_FEATURES_SUPPORTED
        bool "This enables BLE 4.2 features."
        default y

    config APP_WAKEWORD_ENABLED
        bool "Enable WakeNet assistant capture trigger"
        default y

    config APP_WAKEWORD_RESUME_DELAY_MS
        int "Delay before re-arming WakeNet after assistant activity"
        default 800
        depends on APP_WAKEWORD_ENABLED

    config APP_WAKEWORD_STOP_TIMEOUT_MS
        int "Timeout while stopping WakeNet before capture"
        default 1200
        depends on APP_WAKEWORD_ENABLED

    config APP_FACE_ENABLED
        bool "Enable animated assistant face"
        default y

    config APP_FACE_FPS
        int "Animated assistant face frame rate"
        range 10 60
        default 60
        depends on APP_FACE_ENABLED

    config APP_FACE_TX_BUFFER_BYTES
        int "Animated face LCD transfer buffer bytes"
        range 4096 32768
        default 8192
        depends on APP_FACE_ENABLED

    config APP_FACE_USE_IMU
        bool "Drive animated assistant face from QMI8658 tilt"
        default y
        depends on APP_FACE_ENABLED

    config APP_FACE_TOUCH_START_ENABLED
        bool "Use screen taps as primary assistant action"
        default y
        depends on APP_FACE_ENABLED

    config APP_FACE_DEBUG_OVERLAY
        bool "Show animated face debug overlay"
        default n
        depends on APP_FACE_ENABLED

    config APP_FACE_PROFILE
        bool "Log animated face renderer performance counters"
        default n
        depends on APP_FACE_ENABLED

endmenu
```
